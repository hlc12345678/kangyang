## main/Kconfig.projbuild
```kconfig
menu "智能药盒配置 (Kangyang)"

    menu "Wi-Fi 配置"

        config WIFI_SSID
            string "Wi-Fi SSID（网络名称）"
            default "MyWiFiSSID"
            help
                输入要连接的 Wi-Fi 网络名称（SSID）。

        config WIFI_PASSWORD
            string "Wi-Fi 密码"
            default "MyWiFiPassword"
            help
                输入 Wi-Fi 密码。如果是开放网络，请留空。

    endmenu

    menu "豆包 AI 任务配置"

        config DOUBAO_TASK_STACK_SIZE
            int "豆包任务栈大小（字节）"
            default 8192
            range 4096 65536
            help
                豆包 AI 对话 FreeRTOS 任务的栈大小（字节）。
                由于需要处理较大的 JSON 数据，建议不低于 8192 字节。
                若开启了将任务栈分配在 PSRAM，可适当增大此值。

        config DOUBAO_TASK_PRIORITY
            int "豆包任务优先级"
            default 5
            range 1 25
            help
                豆包 AI 对话 FreeRTOS 任务的优先级。
                数值越大优先级越高（最大值为 configMAX_PRIORITIES - 1）。

    endmenu

endmenu
```

## sdkconfig.defaults
```kconfig
# ESP32-S3 N16R8 默认 SDK 配置
# 适用于：智能药盒项目（kangyang）
# 硬件：ESP32-S3 N16R8（16MB Flash + 8MB PSRAM）

# -------------------------------------------------------
# 目标芯片
# -------------------------------------------------------
CONFIG_IDF_TARGET="esp32s3"

# -------------------------------------------------------
# PSRAM（外部 SPI RAM）配置
# 必须启用，否则 heap_caps_malloc(MALLOC_CAP_SPIRAM) 会失败
# -------------------------------------------------------
CONFIG_SPIRAM=y
CONFIG_SPIRAM_MODE_OCT=y
CONFIG_SPIRAM_SPEED_80M=y
# 支持将任务栈、堆等分配在 PSRAM
CONFIG_SPIRAM_USE_CAPS_ALLOC=y
# 允许将 malloc() 回退到 PSRAM（当内部 SRAM 不足时）
CONFIG_SPIRAM_MALLOC_ALWAYSINTERNAL=16384

# -------------------------------------------------------
# Flash 配置（16MB）
# -------------------------------------------------------
CONFIG_ESPTOOLPY_FLASHSIZE_16MB=y
CONFIG_PARTITION_TABLE_CUSTOM=n

# -------------------------------------------------------
# Wi-Fi 配置
# -------------------------------------------------------
CONFIG_ESP_WIFI_STATIC_RX_BUFFER_NUM=10
CONFIG_ESP_WIFI_DYNAMIC_RX_BUFFER_NUM=32
CONFIG_ESP_WIFI_DYNAMIC_TX_BUFFER_NUM=32

# -------------------------------------------------------
# TLS / HTTPS 配置（使用内置证书包）
# -------------------------------------------------------
CONFIG_MBEDTLS_CERTIFICATE_BUNDLE=y
CONFIG_MBEDTLS_CERTIFICATE_BUNDLE_DEFAULT_FULL=y
# 增大 TLS 接收缓冲区，适应大模型的长响应
CONFIG_MBEDTLS_SSL_IN_CONTENT_LEN=16384
CONFIG_MBEDTLS_SSL_OUT_CONTENT_LEN=4096

# -------------------------------------------------------
# HTTP 客户端
# -------------------------------------------------------
CONFIG_ESP_HTTP_CLIENT_ENABLE_HTTPS=y

# -------------------------------------------------------
# 日志级别（开发阶段建议 DEBUG，生产环境改为 WARN）
# -------------------------------------------------------
CONFIG_LOG_DEFAULT_LEVEL_DEBUG=y
CONFIG_LOG_DEFAULT_LEVEL=4

# -------------------------------------------------------
# 用户配置（Wi-Fi / 豆包任务）
# ⚠️  警告：以下 Wi-Fi 凭据为默认占位符，请修改后再使用。
#     切勿将真实凭据提交到版本控制系统（如 Git）中。
#     建议在本地创建 sdkconfig.local（已加入 .gitignore）来覆盖这些值。
# -------------------------------------------------------
CONFIG_WIFI_SSID="YourWiFiSSID"
CONFIG_WIFI_PASSWORD="YourWiFiPassword"
CONFIG_DOUBAO_TASK_STACK_SIZE=8192
CONFIG_DOUBAO_TASK_PRIORITY=5
```
